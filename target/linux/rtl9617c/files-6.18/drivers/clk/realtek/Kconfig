## target/linux/rtl9617c/files-6.18/drivers/clk/realtek/Kconfig
```kconfig
# SPDX-License-Identifier: GPL-2.0-only
config CLK_RTL9617C_CPU
	bool "Realtek RTL9617C CPU clock"
	depends on ARCH_RTL9617C && OF
	select PM_OPP
	help
	  CPU PLL clock of the Realtek RTL9617C SoC. cpufreq-dt scales it
	  through the CPU OPP table.
```

## target/linux/rtl9617c/files-6.18/drivers/net/ethernet/realtek/rtl9617c/Kconfig
```kconfig
# SPDX-License-Identifier: GPL-2.0-only

config RTL9617C_PE
	tristate "Realtek RTL9617C packet engine (PE) support"
	depends on ARCH_REALTEK_TAURUS || COMPILE_TEST
	depends on OF && HAS_IOMEM && HAS_DMA
	select FW_LOADER
	help
	  Packet engine cores of Realtek RTL9617C SoCs. Boots the two MIPS32
	  Taroko PE cores from rtl9617c/pe-radio.bin and publishes radio
	  contexts to them for the wireless hardware data path.

	  To compile this driver as a module, choose M here: the module
	  will be called rtl9617c-pe.

config RTL9617C_NI
	tristate "Realtek RTL9617C network interface support"
	depends on ARCH_REALTEK_TAURUS || COMPILE_TEST
	depends on OF && HAS_IOMEM && HAS_DMA
	select PHYLINK
	select REGMAP_MMIO
	help
	  Network interface of Realtek RTL9617C SoCs. Each Ethernet port in
	  the device tree is its own network device.

	  To compile this driver as a module, choose M here: the module
	  will be called rtl9617c-ni.

if RTL9617C_NI

config RTL9617C_FE
	bool "Flow engine offload"
	depends on BRIDGE && (BRIDGE = y || RTL9617C_NI = m)
	depends on NETFILTER_INGRESS && INET
	select NETFILTER_FAMILY_BRIDGE
	select RTL9617C_SKB_EXT
	help
	  Offload routed and bridged flows to the RTL9617C flow engine
	  through the flow block API (tc flower, netfilter flowtable).

config RTL9617C_WIFI
	tristate "Wi-Fi hardware data path"
	depends on RTL9617C_FE && (RTL9617C_NI = y || m)
	depends on NETFILTER
	help
	  mac80211 Ethernet-converged Wi-Fi data path of Realtek RTL9617C
	  SoCs. Registers AP netdevices with the NI Wi-Fi queues and
	  programs the flow engine for their ingress and peer routes.

	  To compile this driver as a module, choose M here: the module
	  will be called rtl9617c-wifi.

config RTL9617C_BOSA
	tristate "Optical front end (BOSA) support"
	depends on I2C
	select FW_LOADER
	help
	  Calibration of the optical front end on the RTL9617C PON port.
	  The module will be called rtl9617c-bosa.

config RTL9617C_PON
	tristate "PON MAC (EPON / GPON / XG(S)-PON) support"
	depends on RTL9617C_BOSA
	select FW_LOADER
	select CRYPTO_AES
	select CRYPTO_CMAC
	select CRYPTO_LIB_AES
	select RTL9617C_SKB_EXT
	help
	  EPON, GPON and XG(S)-PON MAC of Realtek RTL9617C SoCs.
	  The module will be called rtl9617c-pon.

endif # RTL9617C_NI

config RTL9617C_SKB_EXT
	bool
	select SKB_EXTENSIONS
```
